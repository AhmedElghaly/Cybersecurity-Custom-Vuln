## buildroot-2024.02.8/package/custom_vuln/Config.in
```kconfig
config BR2_PACKAGE_CUSTOM_VULN
    bool "Precompiled vulnerable application"
    help
      Adds a precompiled vulnerable application ELF file to the target system.
```
